## Kconfig
```kconfig
mainmenu "AliOS-Things Config"

source "drivers/Kconfig"
source "hardware/chip/Kconfig"
```

## drivers/intc/Kconfig.gic
```kconfig
config GIC
	bool 

config GIC_V1
	bool 
	select GIC
	help
		The ARM Generic Interrupt Controller v1

config GIC_V2
	bool 
	select GIC 
	help
		The ARM Generic Interrupt Controller v2

config GIC_V3
	bool 
	select GIC
	help 
		The ARM Generic Interrupt Controller v3

config GIC_VER
	int
	depends on GIC
	default 1 if GIC_V1
	default 2 if GIC_V2
	default 3 if GIC_V3
```

## hardware/chip/Kconfig
```kconfig
menu "SoC/CPU/Chip Configuration Selection"

source "hardware/chip/qemu_arm64/Kconfig"

endmenu 
```

## hardware/chip/qemu_arm64/Kconfig
```kconfig
config QEMU_USE_GICV3
    bool "QEMU aarch64 using GIC V3"

config QEMU_AARCH64
    bool "QEMU Virtual Machine on aarch64"
    select GIC_V3 if QEMU_USE_GICV3 
```
